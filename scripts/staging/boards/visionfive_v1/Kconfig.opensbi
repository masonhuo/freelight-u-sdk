## scripts/staging/boards/visionfive_v1/Kconfig.opensbi
```kconfig
menu "OpenSBI build configuration"

choice OPENSBI_GIT_REPO
	bool "Build choice"

config OPENSBI_GIT_REPO_R
	bool "Build from Remote REPO"

config OPENSBI_GIT_REPO_L
	bool "Build from local branch or commit"

endchoice

if OPENSBI_GIT_REPO_R

config OPENSBI_GIT_REMOTE
	string "OpenSBI Remote REPO name"
	default "origin"

config OPENSBI_GIT_RBRANCH
	string "The branch we will use in OpenSBI Remote REPO"
	default "master"

endif

if OPENSBI_GIT_REPO_L

config OPENSBI_GIT_LBRANCH
	string "The branch/commit we will use in local REPO"
	default "master"

endif

config OPENSBI_BUILD_PLATFORM
	string "The build platform"
	default "generic"

config OPENSBI_PREBUILD_UBOOT_BIN
	string "Pre-build U-boot Bin path"
	default ""

config OPENSBI_PREBUILD_DTB
	string "Pre-build dtb path"
	default ""

endmenu
```
